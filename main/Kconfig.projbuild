## main/Kconfig.projbuild
```kconfig
menu "HYP2003 signer"
config HYP_UART_BAUD
    int "Protocol UART0 baud rate"
    default 115200
    range 9600 2000000
config HYP_SILENT_LOGS
    bool "Silence application logs"
    default n
config HYP_LOG_TX_PIN
    int "UART1 log TX GPIO (connect a separate adapter)"
    default 17
    range 0 48
    depends on !HYP_SILENT_LOGS
config HYP_USB_TIMEOUT_MS
    int "CCID transaction timeout (including time extensions)"
    default 10000
    range 1000 60000
config HYP_DEFAULT_PIN
    string "Initial PIN (prefer gitignored secrets fragment)"
    default ""
config HYP_PUK
    string "Reserved PUK (not used by firmware)"
    default ""
config HYP_WEB_ADMIN_PASSWORD
    string "Initial web administrator password"
    default ""
choice HYP_WEB_HTTP_MODE
    prompt "HTTP mode"
    default HYP_WEB_HTTP_REDIRECT
config HYP_WEB_HTTP_REDIRECT
    bool "redirect"
config HYP_WEB_HTTP_SERVE
    bool "serve"
config HYP_WEB_HTTP_OFF
    bool "off"
endchoice
endmenu
```

## sdkconfig.defaults
```kconfig
CONFIG_IDF_TARGET="esp32s3"
CONFIG_ESP_CONSOLE_NONE=y
CONFIG_ESP_CONSOLE_SECONDARY_NONE=y
CONFIG_BOOTLOADER_LOG_LEVEL_NONE=y
CONFIG_LOG_DEFAULT_LEVEL_WARN=y
CONFIG_ESP_MAIN_TASK_STACK_SIZE=32768
CONFIG_FREERTOS_WATCHPOINT_END_OF_STACK=y
CONFIG_COMPILER_OPTIMIZATION_PERF=y
CONFIG_ESPTOOLPY_FLASHSIZE_4MB=y
CONFIG_MBEDTLS_AES_C=y
CONFIG_MBEDTLS_SHA1_C=y
CONFIG_PARTITION_TABLE_CUSTOM=y
CONFIG_PARTITION_TABLE_CUSTOM_FILENAME="partitions.csv"
CONFIG_MBEDTLS_PEM_WRITE_C=y
CONFIG_MBEDTLS_PK_WRITE_C=y
CONFIG_MBEDTLS_X509_CREATE_C=y
CONFIG_MBEDTLS_X509_CRT_WRITE_C=y
CONFIG_MBEDTLS_ECP_C=y
CONFIG_MBEDTLS_ECP_DP_SECP256R1_ENABLED=y
CONFIG_MBEDTLS_ASN1_WRITE_C=y
```
